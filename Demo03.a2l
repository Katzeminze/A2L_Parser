/begin PROJECT DEMO "1.0"
/begin HEADER "" VERSION "1.0" PROJECT_NO DEMO /end HEADER
/begin MODULE DIM ""
/begin MOD_PAR "" VERSION "  " ADDR_EPK 0x80040078 EPK "EPK12345678" CUSTOMER_NO "" USER "" PHONE_NO "" ECU "" CPU_TYPE "" MEMORY_LAYOUT PRG_CODE 0x0 0x8000 -1 -1 -1 -1 -1 MEMORY_LAYOUT PRG_DATA 0x8000 0x8000 -1 -1 -1 -1 -1 MEMORY_LAYOUT PRG_CODE 0x10000 0x10000 -1 -1 -1 -1 -1 /end MOD_PAR
/begin MOD_COMMON "" DEPOSIT DIFFERENCE BYTE_ORDER BIG_ENDIAN /end MOD_COMMON
/begin IF_DATA DIM VECTAB_ADDRESS 0xB1EC TRGSEG_ADDRESS 0xF000 DAT_MOD 1 TRG_MOD 39 DISPLAY_TAB 12 DISPLAY_PAR 0xDF56 8 0xF000 0x0 "Syncro" 0 DISPLAY_PAR 0xDF68 20 0xF100 0xF038 "TimeB" 10 DISPLAY_PAR 0xDF92 20 0xF200 0xF03A "TimeC" 100 /end IF_DATA
/begin IF_DATA ASAP1B_MCMESS
 /begin SOURCE "Handshake" 0 0 QP_BLOB 0 20 /end SOURCE
 /begin SOURCE "Block Zündsynchr." 0 0 QP_BLOB 8 20 /end SOURCE
 /begin SOURCE "Block Zeitsynchr." 0 0 QP_BLOB 12 20 /end SOURCE
 /begin TP_BLOB KOMKEN 11 MCTGT 0x12 MCINI KW2000 ZYLZNAME xx ZYLZA 0 ZYLREI "" XRAMOF 0 BLKZ_W 20 BLKZ_Z 10 BAUD1 "$87,1" /begin VS_DEF "" /end VS_DEF /begin PSEUDO_ADR "" /end PSEUDO_ADR SERAM_MODE 5 /end TP_BLOB
/end IF_DATA
/begin CHARACTERISTIC DEMO_CURVE "This is a standard curve: one input and one output." CURVE 0xD3EF DAMOS_KL1 0 FKT256 0.000000 0.996094 /begin AXIS_DESCR STD_AXIS Input_1 SPEED40 7 0.000000 8000.000000 /end AXIS_DESCR IF_DATA DIM DIRECT 0xBD14 FUNCTION_LIST _DEMO_LED /end CHARACTERISTIC
/begin RECORD_LAYOUT DAMOS_KL1 SRC_ADDR_X 1 UBYTE NO_AXIS_PTS_X 2 UBYTE AXIS_PTS_X 3 UBYTE INDEX_INCR DIRECT FNC_VALUES 4 UBYTE COLUMN_DIR DIRECT /end RECORD_LAYOUT
/begin CHARACTERISTIC DEMO_CONSTANT_1 "This is a standard constant value (fixed value)." VALUE 0xB697 DAMOS_FW1 0 DEC 0.000000 255.000000 IF_DATA DIM DIRECT 0xB697 FUNCTION_LIST _DEMO_LED /end CHARACTERISTIC
/begin RECORD_LAYOUT DAMOS_FW1 FNC_VALUES 1 UBYTE COLUMN_DIR DIRECT /end RECORD_LAYOUT
/begin CHARACTERISTIC DEMO_CONSTANT_2 "This is a standard constant value (fixed value)." VALUE 0xB5D3 DAMOS_FW1 0 PERCENT 0.000000 99.609380 IF_DATA DIM DIRECT 0xB5D3 FUNCTION_LIST _DEMO_LED /end CHARACTERISTIC
/begin CHARACTERISTIC DEMO_MAP_1 "This is a standard map - to be displayed in tabular, 3D, XW, WX, ... representation." MAP 0xC469 DAMOS_KF1 0 WINGANGLE 0.000000 90.000000 /begin AXIS_DESCR STD_AXIS Input_1 SPEED40 16 0.000000 8000.000000 /end AXIS_DESCR /begin AXIS_DESCR STD_AXIS Input_2 TPE 6 0.000000 10.000000 /end AXIS_DESCR IF_DATA DIM DIRECT 0xBC2C FUNCTION_LIST _DEMO_FUNCTION /end CHARACTERISTIC
/begin RECORD_LAYOUT DAMOS_KF1 SRC_ADDR_X 1 UBYTE NO_AXIS_PTS_X 2 UBYTE AXIS_PTS_X 3 UBYTE INDEX_INCR DIRECT SRC_ADDR_Y 4 UBYTE NO_AXIS_PTS_Y 5 UBYTE AXIS_PTS_Y 6 UBYTE INDEX_INCR DIRECT FNC_VALUES 7 UBYTE COLUMN_DIR DIRECT /end RECORD_LAYOUT
/begin CHARACTERISTIC DEMO_MAP_2 "This is a standard map - to be displayed in tabular, 3D, XW, WX, ... representation." MAP 0xC5E1 DAMOS_KF1 0 WINGANGLE 0.000000 90.000000 /begin AXIS_DESCR STD_AXIS Input_1 SPEED40 14 0.000000 8000.000000 /end AXIS_DESCR /begin AXIS_DESCR STD_AXIS Input_2 TPE 12 0.000000 10.000000 /end AXIS_DESCR IF_DATA DIM DIRECT 0xBC48 FUNCTION_LIST _DEMO_FUNCTION /end CHARACTERISTIC
/begin COMPU_METHOD DEC "  Decimal value" RAT_FUNC "%3.0" "dec" COEFFS 0 1.000000 0.000000 0 0.000000 1.000000 /end COMPU_METHOD
/begin COMPU_METHOD FKT256 "  Test formula" RAT_FUNC "%6.4" "" COEFFS 0 256.000000 0.000000 0 0.000000 1.000000 /end COMPU_METHOD
/begin COMPU_METHOD SPEED40 "  Quantisation of engine speed 1 bit equals 40 revs" RAT_FUNC "%4.0" "revs" COEFFS 0 1.000000 0.000000 0 0.000000 40.000000 /end COMPU_METHOD
/begin COMPU_METHOD PERCENT "  Percent" RAT_FUNC "%5.2" "%" COEFFS 0 256.000000 0.000000 0 0.000000 100.000000 /end COMPU_METHOD
/begin COMPU_METHOD TPE "  Quantisation of time period." RAT_FUNC "%5.2" "ms/rev." COEFFS 0 1.000000 0.000000 0 0.000000 0.050000 /end COMPU_METHOD
/begin COMPU_METHOD WINGANGLE "  This is a special angle." RAT_FUNC "%6.2" "degrees" COEFFS 0 1.000000 45.000000 0 0.000000 0.750000 /end COMPU_METHOD
/begin COMPU_METHOD HEADANGLE "  This is a special angle" RAT_FUNC "%5.2" "degrees" COEFFS 0 1.000000 -78.000000 0 0.000000 -0.750000 /end COMPU_METHOD
/begin COMPU_METHOD B_TRUE "On/off conversion formula" TAB_VERB "%7.5" "" COMPU_TAB_REF B_TRUE /end COMPU_METHOD
/begin COMPU_TAB V2ATAB "" TAB_NOINTP 5 0 9.000000 1 10.000000 2 12.000000 3 14.000000 4 16.000000 /end COMPU_TAB
/begin COMPU_VTAB SPECIAL_BIT "" TAB_VERB 2 0 "NOT_ACTIV" 1 "ACTIV" /end COMPU_VTAB
/begin COMPU_VTAB B_TRUE "" TAB_VERB 2 0 "False" 1 "True" /end COMPU_VTAB
/begin MEASUREMENT Input_1 "Speed " UBYTE SPEED40 0 0 0.000000 9960.000000 IF_DATA DIM 0x6C INTERN BYTE BIT_MASK 0xFF FUNCTION_LIST _DEMO_FUNCTION /end MEASUREMENT
/begin MEASUREMENT Input_2 "Time " UBYTE TPE 0 0 0.000000 12.750000 IF_DATA DIM 0x71 INTERN BYTE BIT_MASK 0xFF FUNCTION_LIST _DEMO_FUNCTION /end MEASUREMENT
/begin MEASUREMENT Output "Output angle" UBYTE HEADANGLE 0 0 0.000000 90.000000 IF_DATA DIM 0xFD02 INTERN BYTE BIT_MASK 0xFF FUNCTION_LIST _DEMO_FUNCTION /end MEASUREMENT
/begin MEASUREMENT B_RED "Red LED's state. This is a logical on/off value" UBYTE B_TRUE 0 0 0.000000 1.000000 IF_DATA DIM 0x5B INTERN BYTE BIT_MASK 0x1 FUNCTION_LIST _DEMO_LED /end MEASUREMENT
/begin MEASUREMENT B_GREEN "Green LED's state. This is a logical on/off value" UBYTE B_TRUE 0 0 0.000000 1.000000 IF_DATA DIM 0x5B INTERN BYTE BIT_MASK 0x2 FUNCTION_LIST _DEMO_LED /end MEASUREMENT
/begin MEASUREMENT B_YELLOW "Yellow LED's. This is a logical on/off value" UBYTE B_TRUE 0 0 0.000000 1.000000 IF_DATA DIM 0x5B INTERN BYTE BIT_MASK 0x4 FUNCTION_LIST _DEMO_LED /end MEASUREMENT
/begin FUNCTION _DEMO_FUNCTION "Could be idle, 1->2 gear shift, injection, ignition, ..." /end FUNCTION
/begin FUNCTION _DEMO_LED "Signals/control parameters belonging to the LEDs." /end FUNCTION
/end MODULE
/end PROJECT
